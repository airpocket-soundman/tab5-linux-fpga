## linux/buildroot-external/package/tab5-gpio/Config.in
```kconfig
config BR2_PACKAGE_TAB5_GPIO
	bool "Tab5 shell and MicroPython GPIO support"
	depends on BR2_riscv
	depends on !BR2_USE_MMU
	help
	  GPIO character-device v2 client restricted to selected Tab5 external
	  pins. Requires the matching isolated GPIO driver patch and GPIO_CDEV.
	  Builds tab5-gpio and enables tab5gpio.Pin when micropython-nommu is
	  selected. This option does not configure or drive any GPIO at boot.
```

## linux/buildroot-external/package/tab5-tools/Config.in
```kconfig
config BR2_PACKAGE_TAB5_TOOLS
	bool "Tab5 peripheral tools"
	help
	  GPIO character-device client, peripheral inventory, BMP framebuffer
	  viewer and bounded V4L2 single-frame YUYV capture to BMP.
	  Does not enable a USB host controller or change board pin assignments.
```

## linux/tab5/terminal-apps/defconfig
```kconfig
BR2_riscv=y
BR2_RISCV_32=y
BR2_riscv_custom=y
BR2_RISCV_ISA_RVI=y
BR2_RISCV_ISA_RVM=y
BR2_RISCV_ISA_RVA=y
BR2_RISCV_ISA_RVC=y
# BR2_RISCV_ISA_RVF is not set
# BR2_RISCV_ISA_RVD is not set
BR2_RISCV_ABI_ILP32=y
# BR2_RISCV_USE_MMU is not set
BR2_BINFMT_FLAT=y
BR2_STATIC_LIBS=y
BR2_TOOLCHAIN_BUILDROOT=y
BR2_TOOLCHAIN_BUILDROOT_UCLIBC=y
BR2_TOOLCHAIN_BUILDROOT_WCHAR=y
BR2_KERNEL_HEADERS_6_12=y
BR2_OPTIMIZE_S=y
BR2_INIT_NONE=y
BR2_SYSTEM_BIN_SH_NONE=y
# BR2_PACKAGE_BUSYBOX is not set
BR2_PACKAGE_BUSYBOX_SHOW_OTHERS=y
BR2_PACKAGE_NCURSES=y
BR2_PACKAGE_NCURSES_WCHAR=y
BR2_PACKAGE_NCURSES_ADDITIONAL_TERMINFO="v/vt102 l/linux x/xterm x/xterm-256color"
BR2_PACKAGE_NANO=y
BR2_PACKAGE_NANO_TINY=y
BR2_PACKAGE_SL=y
BR2_PACKAGE_VIM=y
# BR2_PACKAGE_VIM_RUNTIME is not set
# BR2_TARGET_ROOTFS_TAR is not set
# BR2_TARGET_ROOTFS_EXT2 is not set
# BR2_LINUX_KERNEL is not set
```
